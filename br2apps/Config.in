## br2apps/Config.in
```kconfig
source "$BR2_EXTERNAL_APPS_PATH/package/myapp/Config.in"
source "$BR2_EXTERNAL_APPS_PATH/package/beebot_controller/Config.in"
```

## br2apps/package/beebot_controller/Config.in
```kconfig
config BR2_PACKAGE_BEEBOT_CONTROLLER
        bool "BeeBot Controller"
	select BR2_PACKAGE_PYTHON3
	select BR2_PACKAGE_PYTHON_SBUS
	select BR2_PACKAGE_PYTHON_TINYODRIVE
        help
          BeeBot Controller
```
